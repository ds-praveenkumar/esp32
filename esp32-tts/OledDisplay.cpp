#include "OledDisplay.h"
#include <Arduino.h>
#include <Wire.h>

#define OLED_ADDR   0x3C
#define OLED_WIDTH  128
#define OLED_HEIGHT 64
#define FONT_W      6
#define FONT_H      8

OledDisplayClass OledDisplay;

static const uint8_t font[95][6] = {
    {0x00,0x00,0x00,0x00,0x00,0x00},
    {0x00,0x00,0x5F,0x00,0x00,0x00},
    {0x00,0x07,0x00,0x07,0x00,0x00},
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    {0x80,0x80,0x80,0x80,0x80,0x00},
};

void OledDisplayClass::write_cmd(uint8_t cmd)
{
    Wire.beginTransmission(OLED_ADDR);
    Wire.write(0x00);
    Wire.write(cmd);
    Wire.endTransmission();
}

void OledDisplayClass::write_data(const uint8_t *data, size_t len)
{
    for (size_t i = 0; i < len; i += 32) {
        Wire.beginTransmission(OLED_ADDR);
        Wire.write(0x40);
        size_t n = min((size_t)32, len - i);
        for (size_t j = 0; j < n; j++) Wire.write(data[i + j]);
        Wire.endTransmission();
    }
}

void OledDisplayClass::set_cursor(uint8_t page, uint8_t col)
{
    write_cmd(0xB0 + page);
    write_cmd(0x00 + (col & 0x0F));
    write_cmd(0x10 + ((col >> 4) & 0x0F));
}

void OledDisplayClass::clear()
{
    for (int p = 0; p < 8; p++) {
        set_cursor(p, 0);
        uint8_t zeros[OLED_WIDTH] = {0};
        write_data(zeros, OLED_WIDTH);
    }
}

void OledDisplayClass::test_fill()
{
    for (int p = 0; p < 8; p++) {
        set_cursor(p, 0);
        uint8_t pat[OLED_WIDTH];
        for (int i = 0; i < OLED_WIDTH; i++) {
            pat[i] = (p % 2 == 0) ? 0xFF : 0x00;
        }
        write_data(pat, OLED_WIDTH);
    }
    delay(1000);
    clear();
}

void OledDisplayClass::draw_char(uint8_t x, uint8_t page, char c)
{
    if (c < 32 || c > 126) c = ' ';
    c -= 32;
    set_cursor(page, x);
    write_data(font[(uint8_t)c], FONT_W);
}

void OledDisplayClass::draw_string(uint8_t x, uint8_t page, const char *str)
{
    while (*str) {
        if (x + FONT_W > OLED_WIDTH) break;
        draw_char(x, page, *str);
        x += FONT_W;
        str++;
    }
}

void OledDisplayClass::init()
{
    Wire.begin(18, 14);
    delay(100);

    write_cmd(0xAE);
    write_cmd(0x20); write_cmd(0x00);
    write_cmd(0xB0);
    write_cmd(0xC8);
    write_cmd(0x00); write_cmd(0x10);
    write_cmd(0x40);
    write_cmd(0x81); write_cmd(0xFF);
    write_cmd(0xA1);
    write_cmd(0xA6);
    write_cmd(0xA8); write_cmd(0x3F);
    write_cmd(0xA4);
    write_cmd(0xD3); write_cmd(0x00);
    write_cmd(0xD5); write_cmd(0xF0);
    write_cmd(0xD9); write_cmd(0x22);
    write_cmd(0xDA); write_cmd(0x12);
    write_cmd(0xDB); write_cmd(0x20);
    write_cmd(0x8D); write_cmd(0x14);
    write_cmd(0xAF);

    clear();
}

void OledDisplayClass::show(const char *line1, const char *line2)
{
    clear();
    draw_string(0, 0, "ESP32-TTS");
    if (line1) draw_string(0, 3, line1);
    if (line2) draw_string(0, 6, line2);
}
